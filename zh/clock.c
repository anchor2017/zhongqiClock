/***************************************************************************************
 *	FileName					:	clock.c
 *	CopyRight					:
 *	ModuleName				:
 *
 *	CPU							:
 *	RTOS						:
 *
 *	Create Data					:	2017.7.22
 *	Author/Corportation			:	yezhihuo
 *
 *	Abstract Description		:	
 *
 *--------------------------------Revision History--------------------------------------
 *	No	version		Data			Revised By			Item			Description
 *
 *
 ***************************************************************************************/


/**************************************************************
*	Debug switch Section 
**************************************************************/


/**************************************************************
*	Include File Section
**************************************************************/
#include"clock.h"
/**************************************************************
*	Macro Define Section  
**************************************************************/


/**************************************************************
*	Struct Define Section
**************************************************************/


/**************************************************************
*	Prototype Declare Section  ????
**************************************************************/


/**************************************************************
*	Global Variable Declare Section????
**************************************************************/

/**************************************************************
*	Function Define Section??????
**************************************************************/

/**
*  @name: void timeFun() 
*	@description: 时钟计时
 *	@param		:none
 *	@return		: none
 *  @notice : 使用定时器0，程序运行期间始终运行
 */
 void timeFun() interrupt 1
 {
	 TH0 = (65536 - 50000) / 256;
	 TL0 = (65536 - 50000) % 256;
	 if(sb >= 20 )             //20次为1s
	 {
		 sb = 0;
		 write = 1;
			 if( time.second < 59 )
				{
					time.second++;
				}
			 else
			 {
					time.second = 0;                    //时间加1分钟
					if( time.minute <59 )
					{
						time.minute++;
					}
					else
					{
						time.minute = 0;
						dep = 1;
						if( time.hour <23 )                            ///一小时
						{
							time.hour++;
						}
						else
						{
							time.hour = 0;
						}
					}
				}		 
	 }
	 else
	 {
		 sb++;
	 }
 }


